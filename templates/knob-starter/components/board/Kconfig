## templates/knob-starter/components/board/Kconfig
```kconfig
menu "Knob board"

choice KNOB_BOARD
    prompt "Target knob board"
    default KNOB_BOARD_JC3636K518C
    help
        Which round-knob board this image is built for. Pins and capabilities come from
        components/board/include/board_<name>.h; add a second board by adding a header and an
        option here — never by sprinkling #ifdefs through the components.

config KNOB_BOARD_JC3636K518C
    bool "Guition JC3636K518C / Waveshare ESP32-S3-Knob-Touch-LCD-1.8 (no LED ring, ESP32 BT sidecar)"

endchoice

endmenu
```

## templates/knob-starter/components/testctl/Kconfig
```kconfig
menu "Knob test control"

config KNOB_TESTCTL
    bool "Serial test console on USB Serial/JTAG (inject knob/tap, dump screen)"
    default y
    help
        A line-oriented console on the USB Serial/JTAG port for automated verification:
        `knob +3`, `tap`, `hold`, `reset`, `state`, `snap`. Replies start with "> ". `snap` streams the LVGL
        framebuffer as base64 rows prefixed "S:" (host: scripts/testctl.py). Disable for
        production images.

endmenu
```
